## components/logger/Kconfig.projbuild
```kconfig
menu "SDCARD option"

    config SPI_SDCARD_SUPPORT
        bool "USE SPI for sdcard"
        default y
        help
            use SPI port for sdcard

    config SPI_SCARD_PIN_MISO
        int "miso pin"
        default 2
        depends on SPI_SDCARD_SUPPORT
        help
            MISO pin for SDCARD

    config SPI_SCARD_PIN_MOSI
        int "mosi pin"
        default 15
        depends on SPI_SDCARD_SUPPORT
        help
            MOSI pin for SDCARD

    config SPI_SCARD_PIN_CLK
        int "clk pin"
        default 14
        depends on SPI_SDCARD_SUPPORT
        help
            CLK pin for SDCARD

    config SPI_SCARD_PIN_CS
        int "CS pin"
        default 13
        depends on SPI_SDCARD_SUPPORT
        help
            CS pin for SDCARD

    config SPI_SCARD_PORT
        int "spi port"
        default 1
        depends on SPI_SDCARD_SUPPORT
        help
            SPI PORT for SDCARD
endmenu
```

## components/smart_config/Kconfig.projbuild
```kconfig
menu "STATUS LED"
   
    config STATUS_LED_PIN 
        int "STATUS LED GPIO PIN"
        default 22
        help
            GPIO number for status led 

endmenu
```

## main/Kconfig.projbuild
```kconfig
menu "Wifi Debugger board options"
    choice 
        prompt "Main board select"

        if IDF_TARGET_ESP32S3

            config WIFI_DEBUGGER_V_0_4
                bool "Wifi debugger v0.4 main board"
                help
                    Wifi debugger v0.4 main board(esp32S3)

        endif # IDF_TARGET_ESP32S3

        if IDF_TARGET_ESP32C3
             
            config WIFI_DEBUGGER_V_0_2
                bool "Wifi debugger v0.2, v0.3 main board"
                help
                    Wifi debugger v0.2 main board

            config WIFI_DEBUGGER_V_0_1
                bool "Wifi debugger v0.1 main board"
                help
                    Wifi debugger v0.1 main board
            
        endif # IDF_TARGET_ESP32C3

        if IDF_TARGET_ESP32
            config M5STACK_CORE
                bool "For M5STACK"
                help
                    using m5 stack core

            config TTGO_T1
                bool "For TTGO_T1"
                help
                    using ttgo t1 board

        endif # IDF_TARGET_ESP32
    endchoice

    choice 
        prompt "SDCARD BUS select"

        config SD_SDIO_4BIT
            bool "Using SDIO 4Bit bus for SDCARD"
            help
                using sdio bus for SDCARD
            depends on IDF_TARGET_ESP32S3

        config SD_SDIO_1BIT
            bool "Using SDIO 1Bit bus for SDCARD"
            help
                using sdio bus for SDCARD
            depends on IDF_TARGET_ESP32S3

        config SD_SPI
            bool "Using SPI bus for SDCARD"
            default y
            help
                using spi bus for SDCARD

    endchoice
endmenu
```
